## CMakeLists.txt
```
# SPDX-License-Identifier: Apache-2.0

set(SHIELD adafruit_2_8_tft_touch_v2)

cmake_minimum_required(VERSION 3.20.0)

find_package(Zephyr REQUIRED HINTS $ENV{ZEPHYR_BASE})
project(embsys330_final_project_app)

target_sources(app PRIVATE src/main.c)
target_sources(app PRIVATE src/bluetooth.c)
target_sources(app PRIVATE src/bt_db.c)
target_sources(app PRIVATE src/commands.c)

# Add custom linker section to relocate framebuffers to SRAM2
zephyr_linker_sources_ifdef(CONFIG_LV_Z_VBD_CUSTOM_SECTION
  SECTIONS dc_ram.ld)
```

## prj.conf
```kconfig
CONFIG_LV_Z_MEM_POOL_SIZE=16384
CONFIG_LV_Z_SHELL=y
CONFIG_MAIN_STACK_SIZE=2048

CONFIG_DISPLAY=y
CONFIG_DISPLAY_LOG_LEVEL_ERR=y

CONFIG_LOG=y
CONFIG_SHELL=y

CONFIG_LVGL=y
CONFIG_LV_MEM_CUSTOM=y
CONFIG_LV_USE_LOG=y
CONFIG_LV_USE_LABEL=y
CONFIG_LV_USE_BTN=y
CONFIG_LV_USE_ARC=y
CONFIG_LV_USE_IMG=y
CONFIG_LV_USE_MONKEY=y
CONFIG_LV_FONT_MONTSERRAT_14=y

# Enable thread awareness for debugging tools supporting it
CONFIG_DEBUG_THREAD_INFO=y

# enable to use thread names
CONFIG_THREAD_NAME=y
```

## boards/disco_l475_iot1.conf
```kconfig
# Move the video buffer to fill the 32k SRAM2 block.
CONFIG_LV_Z_VBD_CUSTOM_SECTION=y
CONFIG_LV_Z_VDB_SIZE=14

# Enable filesystem and POSIX APIs
CONFIG_FILE_SYSTEM=y
CONFIG_POSIX_FILE_SYSTEM=y
CONFIG_DISK_ACCESS=y
CONFIG_FAT_FILESYSTEM_ELM=y

# Enable newlib libc to support SQLite
CONFIG_NEWLIB_LIBC=y
CONFIG_NEWLIB_LIBC_FLOAT_PRINTF=y

# Optional: Disable unneeded features for SQLite
CONFIG_MINIMAL_LIBC=n

# Configure BT
CONFIG_BT=y
CONFIG_BT_OBSERVER=y

# Configure events
CONFIG_EVENTS=y

# Configure head for dynamic allocation
CONFIG_HEAP_MEM_POOL_SIZE=4096
```

## src/main.c
```c
/*
 * Copyright (c) 2018 Jan Van Winkel <jan.van_winkel@dxplore.eu>
 *
 * SPDX-License-Identifier: Apache-2.0
 */

#include <zephyr/bluetooth/bluetooth.h>
#include <zephyr/device.h>
#include <zephyr/devicetree.h>
#include <zephyr/drivers/display.h>
#include <zephyr/drivers/gpio.h>
#include <lvgl.h>
#include <stdio.h>
#include <string.h>
#include <zephyr/kernel.h>
#include <lvgl_input_device.h>

#include "bluetooth.h"

#define COLOR_RED 0xFF0000
#define COLOR_GREEN 0x00FF00
#define COLOR_GRAY 0x2D3639
#define COLOR_LIGHT_GRAY 0x6F8187
#define COLOR_WHITE 0xFFFFFF
#define COLOR_BLACK 0x000000

static void set_default_box_styling(lv_obj_t *box);
static void set_scan_label(lv_obj_t *label, bool scan_mode);
static void render_scan_table(lv_coord_t y_offset);

#define LOG_LEVEL CONFIG_LOG_DEFAULT_LEVEL
#include <zephyr/logging/log.h>
LOG_MODULE_REGISTER(app);

#ifdef CONFIG_GPIO
static struct gpio_dt_spec button_gpio = GPIO_DT_SPEC_GET_OR(DT_ALIAS(sw0), gpios, {0});
static struct gpio_callback button_callback;

extern struct k_event toggle_scan_type_event;

static void button_isr_callback(const struct device *port, struct gpio_callback *cb, uint32_t pins)
{
	ARG_UNUSED(port);
	ARG_UNUSED(cb);
	ARG_UNUSED(pins);

	k_event_set(&toggle_scan_type_event, 1);
}
#endif /* CONFIG_GPIO */

#ifdef CONFIG_LV_Z_ENCODER_INPUT
static const struct device *lvgl_encoder =
	DEVICE_DT_GET(DT_COMPAT_GET_ANY_STATUS_OKAY(zephyr_lvgl_encoder_input));
#endif /* CONFIG_LV_Z_ENCODER_INPUT */

#ifdef CONFIG_LV_Z_KEYPAD_INPUT
static const struct device *lvgl_keypad =
	DEVICE_DT_GET(DT_COMPAT_GET_ANY_STATUS_OKAY(zephyr_lvgl_keypad_input));
#endif /* CONFIG_LV_Z_KEYPAD_INPUT */

int main(void)
{
	const struct device *display_dev;
	lv_coord_t screen_width = lv_disp_get_hor_res(NULL);
	lv_coord_t screen_height = lv_disp_get_ver_res(NULL);

	display_dev = DEVICE_DT_GET(DT_CHOSEN(zephyr_display));
	if (!device_is_ready(display_dev)) {
		LOG_ERR("Device not ready, aborting test");
		return 0;
	}

#ifdef CONFIG_GPIO
	if (gpio_is_ready_dt(&button_gpio)) {
		int err;

		err = gpio_pin_configure_dt(&button_gpio, GPIO_INPUT);
		if (err) {
			LOG_ERR("failed to configure button gpio: %d", err);
			return 0;
		}

		gpio_init_callback(&button_callback, button_isr_callback, BIT(button_gpio.pin));

		err = gpio_add_callback(button_gpio.port, &button_callback);
		if (err) {
			LOG_ERR("failed to add button callback: %d", err);
			return 0;
		}

		err = gpio_pin_interrupt_configure_dt(&button_gpio, GPIO_INT_EDGE_TO_ACTIVE);
		if (err) {
			LOG_ERR("failed to enable button callback: %d", err);
			return 0;
		}
	}
#endif /* CONFIG_GPIO */

#ifdef CONFIG_LV_Z_ENCODER_INPUT
	lv_obj_t *arc;
	lv_group_t *arc_group;

	arc = lv_arc_create(lv_scr_act());
	lv_obj_align(arc, LV_ALIGN_CENTER, 0, -15);
	lv_obj_set_size(arc, 150, 150);

	arc_group = lv_group_create();
	lv_group_add_obj(arc_group, arc);
	lv_indev_set_group(lvgl_input_get_indev(lvgl_encoder), arc_group);
#endif /* CONFIG_LV_Z_ENCODER_INPUT */

#ifdef CONFIG_LV_Z_KEYPAD_INPUT
	lv_obj_t *btn_matrix;
	lv_group_t *btn_matrix_group;
	static const char *const btnm_map[] = {"1", "2", "3", "4", ""};

	btn_matrix = lv_btnmatrix_create(lv_scr_act());
	lv_obj_align(btn_matrix, LV_ALIGN_CENTER, 0, 70);
	lv_btnmatrix_set_map(btn_matrix, (const char **)btnm_map);
	lv_obj_set_size(btn_matrix, 100, 50);

	btn_matrix_group = lv_group_create();
	lv_group_add_obj(btn_matrix_group, btn_matrix);
	lv_indev_set_group(lvgl_input_get_indev(lvgl_keypad), btn_matrix_group);
#endif /* CONFIG_LV_Z_KEYPAD_INPUT */

	const lv_coord_t top_bar_height = screen_height * 0.15;
	// Create and style top status bar
	lv_obj_t *top_bar = lv_obj_create(lv_scr_act());
	lv_obj_set_size(top_bar, screen_width, top_bar_height);
	lv_obj_set_style_bg_color(top_bar, lv_color_hex(COLOR_GRAY), 0);
	set_default_box_styling(top_bar);
	lv_obj_align(top_bar, LV_ALIGN_TOP_LEFT, 0, 0);

	// Create and style main content box
	lv_obj_t *main = lv_obj_create(lv_scr_act());
	lv_obj_set_size(main, screen_width, screen_height - top_bar_height);
	lv_obj_set_style_bg_color(main, lv_color_hex(COLOR_LIGHT_GRAY), 0);
	set_default_box_styling(main);
	lv_obj_align(main, LV_ALIGN_TOP_LEFT, 0, top_bar_height);

	lv_obj_t *scan_label = lv_label_create(lv_scr_act());
	lv_obj_align(scan_label, LV_ALIGN_TOP_LEFT, 5, 10);

	lv_obj_t *scan_count_label = lv_label_create(lv_scr_act());
	lv_obj_align(scan_count_label, LV_ALIGN_TOP_RIGHT, 0, 10);
	lv_obj_set_style_text_color(scan_count_label, lv_color_hex(COLOR_WHITE), 0);

	render_scan_table(top_bar_height);

	char scan_count_str[11] = {0};

	lv_task_handler();
	display_blanking_off(display_dev);

	while (1) {
		bool scan_mode = get_current_scan_mode();
		uint8_t scan_count = get_total_scans();

		sprintf(scan_count_str, "Scans: %d", scan_count);
		lv_label_set_text(scan_count_label, scan_count_str);

		set_scan_label(scan_label, scan_mode);
		lv_task_handler();
		k_sleep(K_MSEC(10));
	}
}

/**
 * Removes all padding, margin, and radius styling on an object.
 * This is meant primary for boxes.
 */
static void set_default_box_styling(lv_obj_t *box) {
	lv_obj_set_style_pad_all(box, 0, 0);
	lv_obj_set_style_border_width(box, 0, 0);
	lv_obj_set_style_radius(box, 0, 0);
}

/**
 * Sets the content and styles the scan label displayed
 * at the top bar.
 */
static void set_scan_label(lv_obj_t *label, bool scan_mode) {
	if (scan_mode == true) {
		lv_label_set_text(label, "ACTIVE");
		lv_obj_set_style_text_color(label, lv_color_hex(COLOR_GREEN), 0);
	} else {
		lv_label_set_text(label, "PASSIVE");
		lv_obj_set_style_text_color(label, lv_color_hex(COLOR_RED), 0);
	}
}

/**
 * @brief Renders the scans table
 * 
 * @param y_offset The vertical offset from the top of the screen
 */
static void render_scan_table(lv_coord_t y_offset) {
	lv_obj_t *name_header = lv_label_create(lv_scr_act());
	lv_obj_align(name_header, LV_ALIGN_TOP_LEFT, 0, y_offset);
	lv_obj_set_style_text_color(name_header, lv_color_hex(COLOR_BLACK), 0);
	lv_label_set_text(name_header, "Name");

	lv_obj_t *addr_header = lv_label_create(lv_scr_act());
	lv_obj_align(addr_header, LV_ALIGN_TOP_MID, 0, y_offset);
	lv_obj_set_style_text_color(addr_header, lv_color_hex(COLOR_BLACK), 0);
	lv_label_set_text(addr_header, "Address");

	lv_obj_t *rssi_header = lv_label_create(lv_scr_act());
	lv_obj_align(rssi_header, LV_ALIGN_TOP_RIGHT, 0, y_offset);
	lv_obj_set_style_text_color(rssi_header, lv_color_hex(COLOR_BLACK), 0);
	lv_label_set_text(rssi_header, "RSSI");
}
```

## src/bluetooth.c
```c
#include <zephyr/bluetooth/bluetooth.h>
#include <zephyr/kernel.h>
#include <zephyr/logging/log.h>

#include "bluetooth.h"
#include "bt_db.h"

LOG_MODULE_REGISTER(bt_scanner);

static bool extract_bt_device_name_cb(struct bt_data *data, void *user_data);
static void bt_process(void *, void *, void *);
static void bt_scan(void *, void *, void *);
static void bt_scan_cb(const bt_addr_le_t *addr, int8_t rssi, uint8_t type, struct net_buf_simple *ad);

K_EVENT_DEFINE(toggle_scan_type_event);
K_MSGQ_DEFINE(bt_process_msgq, sizeof(struct bt_scan_result), 16, 1);
K_MSGQ_DEFINE(bt_data_req_msgq, sizeof(struct bt_data_req), 16, 1);

K_THREAD_DEFINE(bt_scan_thread_tid, BT_SCAN_THREAD_STACK_SIZE, bt_scan, NULL, NULL, NULL, BT_SCAN_THREAD_PRIORITY, 0, 0);
K_THREAD_DEFINE(bt_process_thread_tid, BT_PROCESS_THREAD_STACK_SIZE, bt_process, NULL, NULL, NULL, BT_PROCESS_THREAD_PRIORITY, 0, 0);

static struct datum *database = NULL;
static int enable_active = 1;
static uint8_t scan_count = 0;

/**
 * @brief Enables Bluetooth, initializes callbacks, and begins scanning for devices.
 * Scans will start in active mode and will update as needed.
 */
static void bt_scan(void *, void *, void *) {
    LOG_DBG("Beginning intialization of Bluetooth...");
	int err = bt_enable(NULL);

	if (err) {
		LOG_ERR("Unable to initialize Bluetooth (error %d)", err);
		return;
	}

	LOG_DBG("Successfully initialized Bluetooth");

	struct bt_le_scan_param bt_scan_params = {
		.type = BT_LE_SCAN_TYPE_ACTIVE,
		.options = BT_LE_SCAN_OPT_FILTER_DUPLICATE,
		.interval = BT_GAP_SCAN_SLOW_INTERVAL_2,
		.window = BT_GAP_SCAN_FAST_WINDOW
	};

	err = bt_le_scan_start(&bt_scan_params, bt_scan_cb);

    while(1) {
        if (k_event_wait(&toggle_scan_type_event, 1, true, K_FOREVER)) {
            enable_active = !enable_active;

            if (enable_active) {
                LOG_DBG("Received request to set BT scan type to active");
                bt_scan_params.type = BT_LE_SCAN_TYPE_ACTIVE;
            } else {
                LOG_INF("Received request to set BT scan type to passive");
                bt_scan_params.type = BT_LE_SCAN_TYPE_PASSIVE;
            }

            LOG_DBG("Restarting Bluetooth scanning due to scan type change");

            // Restart scan with new parameters
            err = bt_le_scan_stop();

            if (err) {
                LOG_ERR("Error %d: Failed to stop Bluetooth scanning", err);
                continue;
            }

            err = bt_le_scan_start(&bt_scan_params, bt_scan_cb);

            if (err) {
                LOG_ERR("Error %d: Failed to start Bluetooth scanning", err);
            }

            LOG_DBG("Successfully restarted Bluetooth scanning with new scan type");
        }
    }
}

/**
 * Callback that processes a Bluetooth scan result
 * and submits to a queue for processing later in a separate thread.
 */
static void bt_scan_cb(const bt_addr_le_t *addr, int8_t rssi, uint8_t type, struct net_buf_simple *ad) {
    scan_count++;
	char addr_str[BT_ADDR_LE_STR_LEN];
	char name[BT_MAX_DEVICE_NAME_LEN] = {0};

	bt_addr_le_to_str(addr, addr_str, sizeof(addr_str));
	bt_data_parse(ad, extract_bt_device_name_cb, name);

	struct bt_scan_result scan_result;
	
	scan_result.addr_str = addr_str;
	scan_result.rssi = rssi;
	scan_result.type = type;
	scan_result.ad = ad;

    strncpy(scan_result.device_name, name, BT_MAX_DEVICE_NAME_LEN - 1);

	LOG_DBG("Queuing an item to the Bluetooth item queue");

	int ret = k_msgq_put(&bt_process_msgq, &scan_result, K_FOREVER);

    if (ret) {
        LOG_ERR("Error %d: Failed to queue a scan result for processing later", ret);
    }
}

/**
 * @brief Processes all data operations for Bluetooth scan packets. This thread
 * will handle incoming data, data retrieval requests, and data clearing requests.
 * 
 * It is important to note that insertion of new data will always occur before a
 * data request is processed.
 */
static void bt_process(void *, void *, void *) {
    extern struct k_event data_print_rdy_event;

    while (1) {
        struct bt_scan_result scan_result;
        struct bt_data_req data_request;

        if (k_msgq_get(&bt_process_msgq, &scan_result, K_NO_WAIT) == 0) {
            LOG_INF("Device found: %s with address %s (RSSI %d), type %u, AD data len %u",
	           scan_result.device_name, scan_result.addr_str, scan_result.rssi, scan_result.type, scan_result.ad->len);

            struct bt_scan_obsv scan_observation = {
                .rssi = scan_result.rssi
            };

            strncpy(scan_observation.addr, scan_result.addr_str, BT_ADDR_LE_STR_LEN);
            strncpy(scan_observation.device_name, scan_result.device_name, BT_MAX_DEVICE_NAME_LEN);

            upsert(&database, &scan_observation);
        }

        if (k_msgq_get(&bt_data_req_msgq, &data_request, K_NO_WAIT) == 0) {
            if (data_request.request_type == BT_DATA_REQ_GET || data_request.request_type == BT_DATA_REQ_PRINT){
                data_request.result_list = get(database, data_request.get_count);
            } else if (data_request.request_type == BT_DATA_REQ_CLEAR) {
                clear(&database);
            }

            if (data_request.request_type == BT_DATA_REQ_PRINT) {
                k_event_set(&data_print_rdy_event, 1);
            }
        };

        k_msleep(100);
        
    }
}

/**
 * Processes the Bluetooth data buffer of a scan and
 * retrieves the name, if it is known.
 */
static bool extract_bt_device_name_cb(struct bt_data *data, void *user_data) {
    char *name = user_data;

    if (data->type != BT_DATA_NAME_COMPLETE && data->type != BT_DATA_NAME_SHORTENED) {
        strncpy(name, "unknown", BT_MAX_DEVICE_NAME_LEN - 1);
        return false;
    }

    size_t len = MIN(data->data_len, BT_MAX_DEVICE_NAME_LEN - 1);
    strncpy(name, data->data, len);

    return true;
}

/**
 * Returns the current scan mode. Can only ever either
 * BT_LE_SCAN_ACTIVE or BT_LE_SCAN_PASSIVE.
 */
bool get_current_scan_mode() {
    if (enable_active) {
        return true;
    }
    
    return false;
}


uint8_t get_total_scans() {
    return scan_count;
}
```

## src/bluetooth.h
```c
#include <zephyr/bluetooth/bluetooth.h>

// Device name cannot be longer than 30 due to the size of a packet
#define BT_DATA_REQ_CLEAR 1
#define BT_DATA_REQ_GET 2
#define BT_DATA_REQ_PRINT 3
#define BT_MAX_DEVICE_NAME_LEN 30
#define BT_PROCESS_THREAD_STACK_SIZE 1024
#define BT_PROCESS_THREAD_PRIORITY 4
#define BT_SCAN_THREAD_STACK_SIZE 1024
#define BT_SCAN_THREAD_PRIORITY 5
#define MAX_SCAN_LABEL_SIZE 16

/**
 * @brief A struct representing Bluetooth advertisements from
 * the Bluetooth module
 */
struct bt_scan_result {
    char *addr_str;
    char device_name[BT_MAX_DEVICE_NAME_LEN];
    int8_t rssi;
    uint8_t type;
    struct net_buf_simple *ad;
};

/**
 * @brief A struct representing a singular Bluetooth observations.
 * 
 * surrogate_key should be a randomly generated uint8_t generated at
 * boot to function as a unqiue identifer for a series of observations.
 * 
 * surrogate_key and sys_tick_elapsed sufficiently identifies a unique slice
 * of time for an observation.
 */
struct bt_scan_obsv {
    char addr[BT_ADDR_LE_STR_LEN];
    char device_name[BT_MAX_DEVICE_NAME_LEN];
    int8_t rssi;
};

/**
 * @brief A struct representing a data request to the Bluetooth data
 * processing request.
 * 
 * The get_count property should be the number of observations to be retrieved
 * from the database. This property is not looked at when request_type
 * is BT_DATA_REQ_CLEAR.
 * 
 * The result property should be a pointer that will hold the result of
 * a BT_DATA_REQ_GET operation. This property will be unchanged in cases
 * of BT_DATA_REQ_CLEAR.
 */
struct bt_data_req {
    int request_type;
    int get_count;
    struct datum * result_list;
};


/**
 * @brief Returns the current scan mode.
 * 
 * @returns True if currently in active scan mode, false if passive.
 */
 bool get_current_scan_mode();

 /**
  * @brief Returns the count of advertising packets
  * scanned
  */
 uint8_t get_total_scans();
```

## src/bt_db.c
```c
#include <stdio.h>
#include <string.h>
#include <zephyr/kernel.h>

#include "bluetooth.h"
#include "bt_db.h"

static void merge_sort(struct datum **head);
static void split_list(struct datum *source, struct datum **front, struct datum **back);
static struct datum * sorted_merge(struct datum *a, struct datum *b);

void upsert(struct datum **head, struct bt_scan_obsv *data) {
    struct datum *new_node = k_malloc(sizeof(struct datum));

    new_node->data = data;
    new_node->next = NULL;

    if (*head == NULL) {
        *head = new_node;
        return;
    }

    struct datum *temp = *head;
    while(temp->next != NULL) {
        char *temp_dev_name = temp->data->device_name;

        // There is an existing node with a matching device name, update RSSI
        if (strcmp(temp_dev_name, data->device_name) == 0) {
            temp->data->rssi = data->rssi;
            merge_sort(head);
            return;
        }

        temp = temp->next;
    };

    temp->next = new_node; 

    merge_sort(head);
}

int len(struct datum *head) {
    int length = 0;

    while (head != NULL) {
        length++;
        head = head->next;
    }

    return length;
}

/**
 * @brief Performs a merge sort on the list of Bluetooth scan observations.
 * Observations are sorted by their RSSI values, with the strongest (lowest value) being at the
 * start of the list.
 * 
 * This sort occurs in place and will modify the original list.
 * 
 * @param head_ref Reference to the start of the list
 */
static void merge_sort(struct datum **head_ref) {
    struct datum *head = *head_ref;

    // Exit early if list is empty or of size 1
    if (!head || !head->next) {
        return;
    }

    struct datum *a;
    struct datum *b;

    split_list(head, &a, &b);

    merge_sort(&a);
    merge_sort(&b);

    *head_ref = sorted_merge(a, b);
}

/**
 * @brief Utility function to split the list in half for a merge sort.
 * 
 * @param source Source list to be split
 * @param front Reference that will hold the first half of the split list
 * @param back Reference that will hold the second half of the split list
 */
static void split_list(struct datum *source, struct datum **front, struct datum **back) {
    // Use two-pointer approach
    struct datum *slow = source;
    struct datum *fast = source->next;

    while (fast) {
        fast = fast->next;

        if (fast) {
            slow = slow->next;
            fast = fast->next;
        }
    }

    *front = source;
    *back = slow->next;
    slow->next = NULL;
}

/**
 * @brief Merges two sorted lists based on their RSSI values. Lower RSSI
 * values indicate higher signal strength are placed first.
 * 
 * @param a Reference to first list
 * @param b Reference to second list
 * 
 * @return Reference to merged, sorted list
 */
static struct datum * sorted_merge(struct datum *a, struct datum *b) {
    if (!a) return b;
    if (!b) return a;

    struct datum *result = NULL;

    if (a->data->rssi >= b->data->rssi) {
        result = a;
        result->next = sorted_merge(a->next, b);
    } else {
        result = b;
        result->next = sorted_merge(a, b->next);
    }

    return result;
}

struct datum * get(struct datum *head, int n) {
    if (n < 0) {
        n = 0;
    }

    int num_nodes_get = MIN(n, len(head));

    struct datum *temp = head;
    struct datum *result = NULL;

    for (int i = 0; i < num_nodes_get; i++) {
        struct bt_scan_obsv *bt_data = temp->data;
        upsert(&result, bt_data);

        temp = temp->next;
    }

    return result;
}

void clear(struct datum **head) {
    struct datum *current = *head;
    struct datum *next;

    while (current != NULL) {
        next = current->next;
        k_free(current);
        current=next;
    }

    *head = NULL;
}
```

## src/bt_db.h
```c
/**
 * bt_db represents an internal database backed by a singly linked
 * list. Each node represents a particular reading from a Bluetooth advertising
 * packet. 
 * 
 * The database is sorted by RSSI values, with lowest appearing at the start of the
 * list. Lower RSSI values correlate to higher signal strength.
 */

struct datum {
    struct bt_scan_obsv *data;
    struct datum *next;
};


/**
 * @brief Returns the length of the list
 */
int len(struct datum *head);

/**
 * @brief Upserts a new datum node into the list. If the device does not
 * exist in the list, it is added to the list. If it does exist, its
 * RSSI value is updated. Devices are uniquely identified by their address.
 * 
 * The list is sorted after every upsert operation to ensure observations with
 * the lowest RSSI values are at the front.
 * 
 * @param head Reference to the head of the list
 * @param data Data to be included in the node.
 */
void upsert(struct datum **head, struct bt_scan_obsv *data);

/**
 * @brief Retrieves upto a certain number of nodes from the list. If the
 * requested number exceeds the length of the list, only the number of nodes
 * match the length are returned.
 * 
 * @param head Reference to the start of the list
 * @param n Number of elements requested
 * 
 * @return A reference to a new list node. This new list is separate from the list,
 * holding no reference to entire list. This is to avoid accidental data manipulation.
 */
struct datum * get(struct datum *head, int n);

/**
 * @brief Clears all data stored in the in-memory database list.
 * 
 * @param head Pointer to a pointer to start of the list
 */
void clear(struct datum **head);
```

## src/commands.c
```c
#include <stdlib.h>
#include <zephyr/kernel.h>
#include <zephyr/shell/shell.h>

#include "bluetooth.h"
#include "bt_db.h"

extern struct k_msgq bt_data_req_msgq;

// This event determines when data is ready to be printed out to the console
K_EVENT_DEFINE(data_print_rdy_event);

/**
 * Handles the get shell command, printing out an error if 
 * the requested number of observations is invalid
 */
static int cmd_get(const struct shell *sh, size_t argc, char** argv)
{
    int count = atoi(argv[1]);

    if (count <= 0) {
        shell_error(sh, "Requested number of records can be <= 0");
        return 1;
    }

    struct datum *results = k_malloc(sizeof(struct datum));
    struct bt_data_req request = {
        .request_type = BT_DATA_REQ_PRINT,
        .get_count = count,
        .result_list = results
    };

    k_msgq_put(&bt_data_req_msgq, &request, K_FOREVER);
    k_event_wait(&data_print_rdy_event, 1, true, K_FOREVER);

    while (results != NULL) {
        struct bt_scan_obsv *observation = results->data;
        shell_print(sh, "%s, %s, %d", observation->addr, observation->device_name, observation->rssi);

        results = results->next;
    }

    return 0;
}

/**
 * Handles the clear shell command
 */
static int cmd_clear(const struct shell *sh, size_t argc, char** argv) {
    struct bt_data_req request = {
        .request_type = BT_DATA_REQ_CLEAR
    };

    k_msgq_put(&bt_data_req_msgq, &request, K_FOREVER);

    return 0;
}

SHELL_STATIC_SUBCMD_SET_CREATE(
    sub_db,
    SHELL_CMD_ARG(get, NULL, "Retrieve a number of observations from the database", cmd_get, 2, 0),
    SHELL_CMD_ARG(clear, NULL, "Clear all observations from the database", cmd_clear, 1, 0)
);

SHELL_CMD_REGISTER(database, &sub_db, "Database commands", NULL);
```

## src/counter.c
```c
/**
 * Simple module for incrementing a global counter.
 * Primarily to demonstrate Ztest
 */

#include "counter.h"

static volatile uint32_t counter;

void counter_reset(void)
{
	counter = 0;
}

void counter_increment(void)
{
	counter++;
}

uint32_t counter_value(void)
{
	return counter;
}
```

## src/counter.h
```c
#pragma once

#include <stdint.h>

void counter_reset(void);
void counter_increment(void);
uint32_t counter_value(void);
```
